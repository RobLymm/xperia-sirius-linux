			somc,novatek_sharp_1080p_panel {
				qcom,mdss-dsi-panel-name = "sharp novatek 1080p video";
				qcom,mdss-dsi-panel-controller = <0x23>;
				qcom,mdss-dsi-panel-type = "dsi_video_mode";
				qcom,mdss-dsi-panel-destination = "display_1";
				qcom,mdss-dsi-panel-framerate = <0x3c>;
				qcom,mdss-dsi-virtual-channel-id = <0x00>;
				qcom,mdss-dsi-stream = <0x00>;
				qcom,mdss-dsi-panel-width = <0x438>;
				qcom,mdss-dsi-panel-height = <0x780>;
				qcom,mdss-dsi-h-front-porch = <0x80>;
				qcom,mdss-dsi-h-back-porch = <0x4c>;
				qcom,mdss-dsi-h-pulse-width = <0x04>;
				qcom,mdss-dsi-h-sync-skew = <0x00>;
				qcom,mdss-dsi-v-back-porch = <0x05>;
				qcom,mdss-dsi-v-front-porch = <0x02>;
				qcom,mdss-dsi-v-pulse-width = <0x02>;
				qcom,mdss-dsi-h-left-border = <0x00>;
				qcom,mdss-dsi-h-right-border = <0x00>;
				qcom,mdss-dsi-v-top-border = <0x00>;
				qcom,mdss-dsi-v-bottom-border = <0x00>;
				qcom,mdss-dsi-bpp = <0x18>;
				qcom,mdss-dsi-underflow-color = <0x00>;
				qcom,mdss-dsi-border-color = <0x00>;
				somc,mdss-dsi-init-command = [15 01 00 00 00 00 02 ff 01 15 01 00 00 00 00 02 fb 01 15 01 00 00 00 00 02 15 14 15 01 00 00 00 00 02 16 12 15 01 00 00 00 00 02 58 82 15 01 00 00 00 00 02 59 00 15 01 00 00 00 00 02 5a 02 15 01 00 00 00 00 02 5b 00 15 01 00 00 00 00 02 5c 82 15 01 00 00 00 00 02 5d 00 15 01 00 00 00 00 02 5e 02 15 01 00 00 00 00 02 5f 00 15 01 00 00 00 00 02 60 0f 15 01 00 00 00 00 02 6d 22 15 01 00 00 00 00 02 ff 05 15 01 00 00 00 00 02 fb 01 15 01 00 00 00 00 02 a6 04 15 01 00 00 00 00 02 c4 04 15 01 00 00 00 00 02 ff 00 15 01 00 00 00 00 02 ff 01 15 01 00 00 00 00 02 fb 01 15 01 00 00 00 00 02 75 00 15 01 00 00 00 00 02 76 21 15 01 00 00 00 00 02 77 00 15 01 00 00 00 00 02 78 57 15 01 00 00 00 00 02 79 00 15 01 00 00 00 00 02 7a 8a 15 01 00 00 00 00 02 7b 00 15 01 00 00 00 00 02 7c a9 15 01 00 00 00 00 02 7d 00 15 01 00 00 00 00 02 7e c1 15 01 00 00 00 00 02 7f 00 15 01 00 00 00 00 02 80 d6 15 01 00 00 00 00 02 81 00 15 01 00 00 00 00 02 82 e4 15 01 00 00 00 00 02 83 00 15 01 00 00 00 00 02 84 f6 15 01 00 00 00 00 02 85 01 15 01 00 00 00 00 02 86 06 15 01 00 00 00 00 02 87 01 15 01 00 00 00 00 02 88 33 15 01 00 00 00 00 02 89 01 15 01 00 00 00 00 02 8a 59 15 01 00 00 00 00 02 8b 01 15 01 00 00 00 00 02 8c 95 15 01 00 00 00 00 02 8d 01 15 01 00 00 00 00 02 8e c5 15 01 00 00 00 00 02 8f 02 15 01 00 00 00 00 02 90 11 15 01 00 00 00 00 02 91 02 15 01 00 00 00 00 02 92 4d 15 01 00 00 00 00 02 93 02 15 01 00 00 00 00 02 94 4f 15 01 00 00 00 00 02 95 02 15 01 00 00 00 00 02 96 77 15 01 00 00 00 00 02 97 02 15 01 00 00 00 00 02 98 a2 15 01 00 00 00 00 02 99 02 15 01 00 00 00 00 02 9a be 15 01 00 00 00 00 02 9b 02 15 01 00 00 00 00 02 9c e5 15 01 00 00 00 00 02 9d 03 15 01 00 00 00 00 02 9e 04 15 01 00 00 00 00 02 9f 03 15 01 00 00 00 00 02 a0 2c 15 01 00 00 00 00 02 a2 03 15 01 00 00 00 00 02 a3 39 15 01 00 00 00 00 02 a4 03 15 01 00 00 00 00 02 a5 46 15 01 00 00 00 00 02 a6 03 15 01 00 00 00 00 02 a7 55 15 01 00 00 00 00 02 a9 03 15 01 00 00 00 00 02 aa 66 15 01 00 00 00 00 02 ab 03 15 01 00 00 00 00 02 ac 7b 15 01 00 00 00 00 02 ad 03 15 01 00 00 00 00 02 ae 95 15 01 00 00 00 00 02 af 03 15 01 00 00 00 00 02 b0 b4 15 01 00 00 00 00 02 b1 03 15 01 00 00 00 00 02 b2 bb 15 01 00 00 00 00 02 b3 00 15 01 00 00 00 00 02 b4 5b 15 01 00 00 00 00 02 b5 00 15 01 00 00 00 00 02 b6 94 15 01 00 00 00 00 02 b7 00 15 01 00 00 00 00 02 b8 c2 15 01 00 00 00 00 02 b9 00 15 01 00 00 00 00 02 ba de 15 01 00 00 00 00 02 bb 00 15 01 00 00 00 00 02 bc f5 15 01 00 00 00 00 02 bd 01 15 01 00 00 00 00 02 be 09 15 01 00 00 00 00 02 bf 01 15 01 00 00 00 00 02 c0 15 15 01 00 00 00 00 02 c1 01 15 01 00 00 00 00 02 c2 26 15 01 00 00 00 00 02 c3 01 15 01 00 00 00 00 02 c4 34 15 01 00 00 00 00 02 c5 01 15 01 00 00 00 00 02 c6 5c 15 01 00 00 00 00 02 c7 01 15 01 00 00 00 00 02 c8 7c 15 01 00 00 00 00 02 c9 01 15 01 00 00 00 00 02 ca ac 15 01 00 00 00 00 02 cb 01 15 01 00 00 00 00 02 cc d2 15 01 00 00 00 00 02 cd 02 15 01 00 00 00 00 02 ce 0d 15 01 00 00 00 00 02 cf 02 15 01 00 00 00 00 02 d0 3b 15 01 00 00 00 00 02 d1 02 15 01 00 00 00 00 02 d2 3d 15 01 00 00 00 00 02 d3 02 15 01 00 00 00 00 02 d4 73 15 01 00 00 00 00 02 d5 02 15 01 00 00 00 00 02 d6 ad 15 01 00 00 00 00 02 d7 02 15 01 00 00 00 00 02 d8 cf 15 01 00 00 00 00 02 d9 02 15 01 00 00 00 00 02 da fe 15 01 00 00 00 00 02 db 03 15 01 00 00 00 00 02 dc 1c 15 01 00 00 00 00 02 dd 03 15 01 00 00 00 00 02 de 44 15 01 00 00 00 00 02 df 03 15 01 00 00 00 00 02 e0 51 15 01 00 00 00 00 02 e1 03 15 01 00 00 00 00 02 e2 5e 15 01 00 00 00 00 02 e3 03 15 01 00 00 00 00 02 e4 6e 15 01 00 00 00 00 02 e5 03 15 01 00 00 00 00 02 e6 7f 15 01 00 00 00 00 02 e7 03 15 01 00 00 00 00 02 e8 93 15 01 00 00 00 00 02 e9 03 15 01 00 00 00 00 02 ea ac 15 01 00 00 00 00 02 eb 03 15 01 00 00 00 00 02 ec ca 15 01 00 00 00 00 02 ed 03 15 01 00 00 00 00 02 ee d1 15 01 00 00 00 00 02 ef 00 15 01 00 00 00 00 02 f0 14 15 01 00 00 00 00 02 f1 00 15 01 00 00 00 00 02 f2 50 15 01 00 00 00 00 02 f3 00 15 01 00 00 00 00 02 f4 84 15 01 00 00 00 00 02 f5 00 15 01 00 00 00 00 02 f6 a4 15 01 00 00 00 00 02 f7 00 15 01 00 00 00 00 02 f8 b9 15 01 00 00 00 00 02 f9 00 15 01 00 00 00 00 02 fa d2 15 01 00 00 00 00 02 ff 02 15 01 00 00 00 00 02 fb 01 15 01 00 00 00 00 02 00 00 15 01 00 00 00 00 02 01 e1 15 01 00 00 00 00 02 02 00 15 01 00 00 00 00 02 03 f1 15 01 00 00 00 00 02 04 01 15 01 00 00 00 00 02 05 02 15 01 00 00 00 00 02 06 01 15 01 00 00 00 00 02 07 31 15 01 00 00 00 00 02 08 01 15 01 00 00 00 00 02 09 56 15 01 00 00 00 00 02 0a 01 15 01 00 00 00 00 02 0b 93 15 01 00 00 00 00 02 0c 01 15 01 00 00 00 00 02 0d c4 15 01 00 00 00 00 02 0e 02 15 01 00 00 00 00 02 0f 0f 15 01 00 00 00 00 02 10 02 15 01 00 00 00 00 02 11 4b 15 01 00 00 00 00 02 12 02 15 01 00 00 00 00 02 13 4c 15 01 00 00 00 00 02 14 02 15 01 00 00 00 00 02 15 75 15 01 00 00 00 00 02 16 02 15 01 00 00 00 00 02 17 a0 15 01 00 00 00 00 02 18 02 15 01 00 00 00 00 02 19 bb 15 01 00 00 00 00 02 1a 02 15 01 00 00 00 00 02 1b e0 15 01 00 00 00 00 02 1c 02 15 01 00 00 00 00 02 1d ff 15 01 00 00 00 00 02 1e 03 15 01 00 00 00 00 02 1f 27 15 01 00 00 00 00 02 20 03 15 01 00 00 00 00 02 21 33 15 01 00 00 00 00 02 22 03 15 01 00 00 00 00 02 23 41 15 01 00 00 00 00 02 24 03 15 01 00 00 00 00 02 25 50 15 01 00 00 00 00 02 26 03 15 01 00 00 00 00 02 27 61 15 01 00 00 00 00 02 28 03 15 01 00 00 00 00 02 29 76 15 01 00 00 00 00 02 2a 03 15 01 00 00 00 00 02 2b 91 15 01 00 00 00 00 02 2d 03 15 01 00 00 00 00 02 2f b3 15 01 00 00 00 00 02 30 03 15 01 00 00 00 00 02 31 bb 15 01 00 00 00 00 02 32 00 15 01 00 00 00 00 02 33 4e 15 01 00 00 00 00 02 34 00 15 01 00 00 00 00 02 35 8f 15 01 00 00 00 00 02 36 00 15 01 00 00 00 00 02 37 be 15 01 00 00 00 00 02 38 00 15 01 00 00 00 00 02 39 db 15 01 00 00 00 00 02 3a 00 15 01 00 00 00 00 02 3b ef 15 01 00 00 00 00 02 3d 01 15 01 00 00 00 00 02 3f 06 15 01 00 00 00 00 02 40 01 15 01 00 00 00 00 02 41 13 15 01 00 00 00 00 02 42 01 15 01 00 00 00 00 02 43 22 15 01 00 00 00 00 02 44 01 15 01 00 00 00 00 02 45 31 15 01 00 00 00 00 02 46 01 15 01 00 00 00 00 02 47 5b 15 01 00 00 00 00 02 48 01 15 01 00 00 00 00 02 49 7b 15 01 00 00 00 00 02 4a 01 15 01 00 00 00 00 02 4b ab 15 01 00 00 00 00 02 4c 01 15 01 00 00 00 00 02 4d d1 15 01 00 00 00 00 02 4e 02 15 01 00 00 00 00 02 4f 0b 15 01 00 00 00 00 02 50 02 15 01 00 00 00 00 02 51 39 15 01 00 00 00 00 02 52 02 15 01 00 00 00 00 02 53 3a 15 01 00 00 00 00 02 54 02 15 01 00 00 00 00 02 55 71 15 01 00 00 00 00 02 56 02 15 01 00 00 00 00 02 58 aa 15 01 00 00 00 00 02 59 02 15 01 00 00 00 00 02 5a cc 15 01 00 00 00 00 02 5b 02 15 01 00 00 00 00 02 5c fa 15 01 00 00 00 00 02 5d 03 15 01 00 00 00 00 02 5e 17 15 01 00 00 00 00 02 5f 03 15 01 00 00 00 00 02 60 3f 15 01 00 00 00 00 02 61 03 15 01 00 00 00 00 02 62 4b 15 01 00 00 00 00 02 63 03 15 01 00 00 00 00 02 64 59 15 01 00 00 00 00 02 65 03 15 01 00 00 00 00 02 66 68 15 01 00 00 00 00 02 67 03 15 01 00 00 00 00 02 68 7a 15 01 00 00 00 00 02 69 03 15 01 00 00 00 00 02 6a 8e 15 01 00 00 00 00 02 6b 03 15 01 00 00 00 00 02 6c a8 15 01 00 00 00 00 02 6d 03 15 01 00 00 00 00 02 6e c9 15 01 00 00 00 00 02 6f 03 15 01 00 00 00 00 02 70 d1 15 01 00 00 00 00 02 71 00 15 01 00 00 00 00 02 72 00 15 01 00 00 00 00 02 73 00 15 01 00 00 00 00 02 74 38 15 01 00 00 00 00 02 75 00 15 01 00 00 00 00 02 76 6c 15 01 00 00 00 00 02 77 00 15 01 00 00 00 00 02 78 8f 15 01 00 00 00 00 02 79 00 15 01 00 00 00 00 02 7a aa 15 01 00 00 00 00 02 7b 00 15 01 00 00 00 00 02 7c bf 15 01 00 00 00 00 02 7d 00 15 01 00 00 00 00 02 7e d5 15 01 00 00 00 00 02 7f 00 15 01 00 00 00 00 02 80 e2 15 01 00 00 00 00 02 81 00 15 01 00 00 00 00 02 82 f3 15 01 00 00 00 00 02 83 01 15 01 00 00 00 00 02 84 27 15 01 00 00 00 00 02 85 01 15 01 00 00 00 00 02 86 4e 15 01 00 00 00 00 02 87 01 15 01 00 00 00 00 02 88 8d 15 01 00 00 00 00 02 89 01 15 01 00 00 00 00 02 8a c0 15 01 00 00 00 00 02 8b 02 15 01 00 00 00 00 02 8c 0d 15 01 00 00 00 00 02 8d 02 15 01 00 00 00 00 02 8e 4b 15 01 00 00 00 00 02 8f 02 15 01 00 00 00 00 02 90 4c 15 01 00 00 00 00 02 91 02 15 01 00 00 00 00 02 92 76 15 01 00 00 00 00 02 93 02 15 01 00 00 00 00 02 94 a1 15 01 00 00 00 00 02 95 02 15 01 00 00 00 00 02 96 bd 15 01 00 00 00 00 02 97 02 15 01 00 00 00 00 02 98 e4 15 01 00 00 00 00 02 99 03 15 01 00 00 00 00 02 9a 03 15 01 00 00 00 00 02 9b 03 15 01 00 00 00 00 02 9c 2d 15 01 00 00 00 00 02 9d 03 15 01 00 00 00 00 02 9e 39 15 01 00 00 00 00 02 9f 03 15 01 00 00 00 00 02 a0 46 15 01 00 00 00 00 02 a2 03 15 01 00 00 00 00 02 a3 56 15 01 00 00 00 00 02 a4 03 15 01 00 00 00 00 02 a5 68 15 01 00 00 00 00 02 a6 03 15 01 00 00 00 00 02 a7 7f 15 01 00 00 00 00 02 a9 03 15 01 00 00 00 00 02 aa 97 15 01 00 00 00 00 02 ab 03 15 01 00 00 00 00 02 ac b5 15 01 00 00 00 00 02 ad 03 15 01 00 00 00 00 02 ae bb 15 01 00 00 00 00 02 af 00 15 01 00 00 00 00 02 b0 39 15 01 00 00 00 00 02 b1 00 15 01 00 00 00 00 02 b2 76 15 01 00 00 00 00 02 b3 00 15 01 00 00 00 00 02 b4 a6 15 01 00 00 00 00 02 b5 00 15 01 00 00 00 00 02 b6 c6 15 01 00 00 00 00 02 b7 00 15 01 00 00 00 00 02 b8 df 15 01 00 00 00 00 02 b9 00 15 01 00 00 00 00 02 ba f2 15 01 00 00 00 00 02 bb 01 15 01 00 00 00 00 02 bc 07 15 01 00 00 00 00 02 bd 01 15 01 00 00 00 00 02 be 13 15 01 00 00 00 00 02 bf 01 15 01 00 00 00 00 02 c0 22 15 01 00 00 00 00 02 c1 01 15 01 00 00 00 00 02 c2 50 15 01 00 00 00 00 02 c3 01 15 01 00 00 00 00 02 c4 72 15 01 00 00 00 00 02 c5 01 15 01 00 00 00 00 02 c6 a5 15 01 00 00 00 00 02 c7 01 15 01 00 00 00 00 02 c8 cd 15 01 00 00 00 00 02 c9 02 15 01 00 00 00 00 02 ca 09 15 01 00 00 00 00 02 cb 02 15 01 00 00 00 00 02 cc 39 15 01 00 00 00 00 02 cd 02 15 01 00 00 00 00 02 ce 3a 15 01 00 00 00 00 02 cf 02 15 01 00 00 00 00 02 d0 72 15 01 00 00 00 00 02 d1 02 15 01 00 00 00 00 02 d2 ac 15 01 00 00 00 00 02 d3 02 15 01 00 00 00 00 02 d4 cf 15 01 00 00 00 00 02 d5 02 15 01 00 00 00 00 02 d6 fe 15 01 00 00 00 00 02 d7 03 15 01 00 00 00 00 02 d8 1c 15 01 00 00 00 00 02 d9 03 15 01 00 00 00 00 02 da 45 15 01 00 00 00 00 02 db 03 15 01 00 00 00 00 02 dc 51 15 01 00 00 00 00 02 dd 03 15 01 00 00 00 00 02 de 5f 15 01 00 00 00 00 02 df 03 15 01 00 00 00 00 02 e0 6f 15 01 00 00 00 00 02 e1 03 15 01 00 00 00 00 02 e2 81 15 01 00 00 00 00 02 e3 03 15 01 00 00 00 00 02 e4 97 15 01 00 00 00 00 02 e5 03 15 01 00 00 00 00 02 e6 ae 15 01 00 00 00 00 02 e7 03 15 01 00 00 00 00 02 e8 cb 15 01 00 00 00 00 02 e9 03 15 01 00 00 00 00 02 ea d1 15 01 00 00 00 00 02 ff 00 05 01 00 00 96 00 01 11 15 01 00 00 00 00 02 d3 07 15 01 00 00 00 00 02 d4 02];
				qcom,mdss-dsi-on-command = <0x5010000 0x129>;
				qcom,mdss-dsi-off-command = <0x5010000 0x14000128 0x5010000 0x64000110>;
				qcom,mdss-dsi-on-command-state = "dsi_lp_mode";
				qcom,mdss-dsi-off-command-state = "dsi_hs_mode";
				somc,mdss-dsi-cabc-early-on-command = <0x39010000 0x351 0xfff1501 0x00 0x2532415 0x1000000 0x25502>;
				somc,mdss-dsi-cabc-late-off-command = <0x39010000 0x351 0x1501 0x00 0x2550015 0x1000000 0x25320>;
				somc,mdss-dsi-cabc-enabled = <0x00>;
				qcom,mdss-dsi-h-sync-pulse = <0x01>;
				qcom,mdss-dsi-traffic-mode = "non_burst_sync_event";
				qcom,mdss-dsi-bllp-eof-power-mode;
				qcom,mdss-dsi-bllp-power-mode;
				qcom,mdss-dsi-lane-0-state;
				qcom,mdss-dsi-lane-1-state;
				qcom,mdss-dsi-lane-2-state;
				qcom,mdss-dsi-lane-3-state;
				qcom,mdss-dsi-panel-timings = <0xe6382600 0x686c2a3a 0x2c030400>;
				qcom,mdss-dsi-lp11-init;
				qcom,mdss-dsi-t-clk-post = <0x02>;
				qcom,mdss-dsi-t-clk-pre = <0x2b>;
				qcom,mdss-dsi-bl-min-level = <0x01>;
				qcom,mdss-dsi-bl-max-level = <0xfff>;
				qcom,mdss-brightness-max-level = <0xfff>;
				qcom,mdss-dsi-dma-trigger = "trigger_sw";
				qcom,mdss-dsi-mdp-trigger = "none";
				qcom,mdss-dsi-bl-pmic-control-type = "bl_ctrl_wled";
				qcom,mdss-dsi-pan-enable-dynamic-fps;
				qcom,mdss-dsi-pan-fps-update = "dfps_suspend_resume_mode";
				qcom,cont-splash-enabled;
				qcom,mdss-dsi-tx-eot-append;
				somc,driver-ic = <0x01>;
				somc,dric-gpio = <0x05 0x1a 0x00>;
				somc,mul-channel-scaling = <0x03>;
				somc,mdss-phy-size-mm = <0x40 0x72>;
				somc,mdss-dsi-lane-config = [00 c2 ef 00 00 00 00 01 75 00 c2 ef 00 00 00 00 01 75 00 c2 ef 00 00 00 00 01 75 00 c2 ef 00 00 00 00 01 75 00 02 45 00 00 00 00 01 97];
				somc,mdss-dsi-disp-on-in-hs = <0x01>;
				somc,lcd-id = <0x01>;
				somc,lcd-id-adc = <0x12dc20 0x154938>;
				somc,disp-en-on-pre = <0x19>;
				somc,pw-on-rst-seq = <0x00 0x3c 0x01 0x0a>;
				somc,disp-en-off-post = <0x32>;
				somc,pw-off-rst-b-seq = <0x00 0x0a>;
				somc,mdss-dsi-pre-uv-command = [15 01 00 00 00 00 02 ff 00];
				somc,mdss-dsi-uv-command = <0x6010000 0x1da 0x6010000 0x1db>;
				somc,mdss-dsi-uv-param-type = <0x02>;
				somc,mdss-dsi-pcc-table-size = <0x49>;
				somc,mdss-dsi-pcc-table = <0x00 0x01 0x10 0x13 0x28 0x2b 0x8000 0x7400 0x8000 0x00 0x02 0x14 0x17 0x28 0x2b 0x7a80 0x7400 0x7e00 0x00 0x03 0x18 0x1b 0x28 0x2b 0x7480 0x7380 0x8000 0x00 0x04 0x1c 0x1f 0x28 0x2b 0x7280 0x7380 0x8000 0x00 0x05 0x20 0x23 0x28 0x2b 0x6e00 0x7400 0x8000 0x00 0x06 0x0c 0x0f 0x24 0x27 0x7f80 0x7200 0x7c00 0x00 0x07 0x10 0x13 0x24 0x27 0x8000 0x7400 0x7d80 0x00 0x08 0x14 0x17 0x24 0x27 0x7d00 0x7700 0x7e00 0x00 0x09 0x18 0x1b 0x24 0x27 0x7700 0x7600 0x8000 0x00 0x0a 0x1c 0x1f 0x24 0x27 0x7380 0x7500 0x7c00 0x00 0x0b 0x20 0x23 0x24 0x27 0x6f00 0x7500 0x7e80 0x00 0x0c 0x0c 0x0f 0x20 0x23 0x7f80 0x7200 0x7900 0x00 0x0d 0x10 0x13 0x20 0x23 0x8000 0x7400 0x7b00 0x00 0x0e 0x14 0x17 0x20 0x23 0x7a80 0x7400 0x7b00 0x00 0x0f 0x18 0x1b 0x20 0x23 0x7800 0x7700 0x7e80 0x00 0x10 0x1c 0x1f 0x20 0x23 0x7780 0x7900 0x7f80 0x00 0x11 0x20 0x23 0x20 0x23 0x7300 0x7900 0x7f00 0x00 0x12 0x24 0x27 0x20 0x23 0x7100 0x7980 0x8000 0x00 0x13 0x0c 0x0f 0x1c 0x1f 0x7f80 0x7200 0x7700 0x00 0x14 0x10 0x13 0x1c 0x1f 0x7c00 0x7000 0x7580 0x00 0x15 0x14 0x17 0x1c 0x1f 0x7f80 0x7900 0x7e00 0x00 0x16 0x18 0x1b 0x1c 0x1f 0x7c00 0x7a00 0x7d80 0x00 0x17 0x1c 0x1f 0x1c 0x1f 0x7900 0x7a00 0x7e00 0x00 0x18 0x20 0x23 0x1c 0x1f 0x7600 0x7c80 0x8000 0x00 0x19 0x24 0x27 0x1c 0x1f 0x7300 0x7c00 0x7e80 0x00 0x1a 0x0c 0x0f 0x18 0x1b 0x8000 0x7200 0x7300 0x00 0x1b 0x10 0x13 0x18 0x1b 0x7e80 0x7200 0x7500 0x00 0x1c 0x14 0x17 0x18 0x1b 0x7f00 0x7900 0x7b80 0x00 0x1d 0x18 0x1b 0x18 0x1b 0x7f00 0x7d00 0x7e00 0x00 0x1e 0x1c 0x1f 0x18 0x1b 0x7d00 0x7d80 0x8000 0x00 0x1f 0x20 0x23 0x18 0x1b 0x7900 0x7f00 0x8000 0x00 0x20 0x24 0x27 0x18 0x1b 0x7780 0x8000 0x8000 0x00 0x21 0x10 0x13 0x14 0x17 0x7f80 0x7380 0x7200 0x00 0x22 0x14 0x17 0x14 0x17 0x7f00 0x7900 0x7900 0x00 0x23 0x18 0x1b 0x14 0x17 0x7f00 0x7d00 0x7b80 0xff 0x00 0x1c 0x1f 0x14 0x17 0x8000 0x8000 0x8000 0x00 0x24 0x20 0x23 0x14 0x17 0x7a00 0x8000 0x7e80 0x00 0x25 0x24 0x27 0x14 0x17 0x7780 0x8000 0x7d80 0x00 0x26 0x10 0x13 0x10 0x13 0x8000 0x7400 0x7000 0x00 0x27 0x14 0x17 0x10 0x13 0x7f80 0x7900 0x7680 0x00 0x28 0x18 0x1b 0x10 0x13 0x8000 0x7d80 0x7980 0x00 0x29 0x1c 0x1f 0x10 0x13 0x8000 0x8000 0x7c00 0x00 0x2a 0x20 0x23 0x10 0x13 0x7a00 0x8000 0x7c00 0x00 0x2b 0x10 0x13 0x0c 0x0f 0x7f80 0x7480 0x6f00 0x00 0x2c 0x14 0x17 0x0c 0x0f 0x7f80 0x7900 0x7400 0x00 0x2d 0x18 0x1b 0x0c 0x0f 0x7f80 0x7d80 0x7680 0x00 0x2e 0x1c 0x1f 0x0c 0x0f 0x8000 0x8000 0x7980 0x01 0x00 0x00 0x09 0x32 0x3b 0x8000 0x6d00 0x8000 0x02 0x00 0x0a 0x13 0x32 0x3b 0x7a00 0x7100 0x8000 0x03 0x00 0x14 0x1d 0x32 0x3b 0x7400 0x7180 0x8000 0x04 0x00 0x1e 0x27 0x32 0x3b 0x7100 0x7200 0x8000 0x05 0x00 0x28 0x31 0x32 0x3b 0x6c80 0x7180 0x8000 0x06 0x00 0x32 0x3b 0x32 0x3b 0x6680 0x7300 0x8000 0x07 0x00 0x00 0x09 0x28 0x31 0x8000 0x6b80 0x7080 0x08 0x00 0x0a 0x13 0x28 0x31 0x8000 0x7400 0x8000 0x09 0x00 0x14 0x1d 0x28 0x31 0x7a00 0x7700 0x8000 0x0a 0x00 0x1e 0x27 0x28 0x31 0x7600 0x7780 0x8000 0x0b 0x00 0x28 0x31 0x28 0x31 0x6f80 0x7980 0x8000 0x0c 0x00 0x32 0x3b 0x28 0x31 0x7080 0x7e80 0x8000 0x0d 0x00 0x00 0x09 0x14 0x27 0x8000 0x6b00 0x6d00 0x0e 0x00 0x0a 0x13 0x14 0x27 0x8000 0x7380 0x7480 0xff 0x00 0x14 0x27 0x14 0x27 0x8000 0x8000 0x8000 0x10 0x00 0x28 0x31 0x14 0x27 0x7500 0x8000 0x7e80 0x11 0x00 0x32 0x3b 0x14 0x27 0x7100 0x8000 0x7c80 0x12 0x00 0x00 0x09 0x00 0x09 0x8000 0x6900 0x6500 0x13 0x00 0x00 0x13 0x0a 0x13 0x8000 0x7300 0x6f00 0x13 0x00 0x0a 0x13 0x00 0x09 0x8000 0x7300 0x6f00 0x14 0x00 0x14 0x27 0x0a 0x13 0x7f00 0x8000 0x7900 0x15 0x00 0x14 0x27 0x00 0x09 0x7e80 0x8000 0x7680 0x16 0x00 0x28 0x31 0x0a 0x13 0x7380 0x8000 0x7600 0x17 0x00 0x32 0x3b 0x0a 0x13 0x7080 0x8000 0x7900 0x18 0x00 0x28 0x31 0x00 0x09 0x7a00 0x8000 0x7580 0x19 0x00 0x32 0x3b 0x00 0x09 0x6f00 0x8000 0x7200>;
			};
