			somc,novatek_jdi_1080p_panel {
				qcom,mdss-dsi-panel-name = "jdi novatek 1080p video";
				qcom,mdss-dsi-panel-controller = <0x23>;
				qcom,mdss-dsi-panel-type = "dsi_video_mode";
				qcom,mdss-dsi-panel-destination = "display_1";
				qcom,mdss-dsi-panel-framerate = <0x3c>;
				qcom,mdss-dsi-virtual-channel-id = <0x00>;
				qcom,mdss-dsi-stream = <0x00>;
				qcom,mdss-dsi-panel-width = <0x438>;
				qcom,mdss-dsi-panel-height = <0x780>;
				qcom,mdss-dsi-h-front-porch = <0x70>;
				qcom,mdss-dsi-h-back-porch = <0x4c>;
				qcom,mdss-dsi-h-pulse-width = <0x04>;
				qcom,mdss-dsi-h-sync-skew = <0x00>;
				qcom,mdss-dsi-v-back-porch = <0x04>;
				qcom,mdss-dsi-v-front-porch = <0x1b>;
				qcom,mdss-dsi-v-pulse-width = <0x04>;
				qcom,mdss-dsi-h-left-border = <0x00>;
				qcom,mdss-dsi-h-right-border = <0x00>;
				qcom,mdss-dsi-v-top-border = <0x00>;
				qcom,mdss-dsi-v-bottom-border = <0x00>;
				qcom,mdss-dsi-bpp = <0x18>;
				qcom,mdss-dsi-underflow-color = <0x00>;
				qcom,mdss-dsi-border-color = <0x00>;
				somc,mdss-dsi-init-command = [05 01 00 00 0a 00 01 01 23 01 00 00 00 00 02 ff 01 23 01 00 00 00 00 02 75 00 23 01 00 00 00 00 02 76 30 23 01 00 00 00 00 02 77 00 23 01 00 00 00 00 02 78 43 23 01 00 00 00 00 02 79 00 23 01 00 00 00 00 02 7a 61 23 01 00 00 00 00 02 7b 00 23 01 00 00 00 00 02 7c 7d 23 01 00 00 00 00 02 7d 00 23 01 00 00 00 00 02 7e 98 23 01 00 00 00 00 02 7f 00 23 01 00 00 00 00 02 80 ae 23 01 00 00 00 00 02 81 00 23 01 00 00 00 00 02 82 c0 23 01 00 00 00 00 02 83 00 23 01 00 00 00 00 02 84 cd 23 01 00 00 00 00 02 85 00 23 01 00 00 00 00 02 86 db 23 01 00 00 00 00 02 87 01 23 01 00 00 00 00 02 88 0a 23 01 00 00 00 00 02 89 01 23 01 00 00 00 00 02 8a 2a 23 01 00 00 00 00 02 8b 01 23 01 00 00 00 00 02 8c 66 23 01 00 00 00 00 02 8d 01 23 01 00 00 00 00 02 8e 95 23 01 00 00 00 00 02 8f 01 23 01 00 00 00 00 02 90 d8 23 01 00 00 00 00 02 91 02 23 01 00 00 00 00 02 92 1a 23 01 00 00 00 00 02 93 02 23 01 00 00 00 00 02 94 1c 23 01 00 00 00 00 02 95 02 23 01 00 00 00 00 02 96 5e 23 01 00 00 00 00 02 97 02 23 01 00 00 00 00 02 98 9a 23 01 00 00 00 00 02 99 02 23 01 00 00 00 00 02 9a bf 23 01 00 00 00 00 02 9b 02 23 01 00 00 00 00 02 9c ed 23 01 00 00 00 00 02 9d 03 23 01 00 00 00 00 02 9e 0b 23 01 00 00 00 00 02 9f 03 23 01 00 00 00 00 02 a0 36 23 01 00 00 00 00 02 a2 03 23 01 00 00 00 00 02 a3 3b 23 01 00 00 00 00 02 a4 03 23 01 00 00 00 00 02 a5 40 23 01 00 00 00 00 02 a6 03 23 01 00 00 00 00 02 a7 45 23 01 00 00 00 00 02 a9 03 23 01 00 00 00 00 02 aa 54 23 01 00 00 00 00 02 ab 03 23 01 00 00 00 00 02 ac 70 23 01 00 00 00 00 02 ad 03 23 01 00 00 00 00 02 ae 8e 23 01 00 00 00 00 02 af 03 23 01 00 00 00 00 02 b0 b2 23 01 00 00 00 00 02 b1 03 23 01 00 00 00 00 02 b2 c9 23 01 00 00 00 00 02 b3 00 23 01 00 00 00 00 02 b4 30 23 01 00 00 00 00 02 b5 00 23 01 00 00 00 00 02 b6 43 23 01 00 00 00 00 02 b7 00 23 01 00 00 00 00 02 b8 61 23 01 00 00 00 00 02 b9 00 23 01 00 00 00 00 02 ba 7d 23 01 00 00 00 00 02 bb 00 23 01 00 00 00 00 02 bc 98 23 01 00 00 00 00 02 bd 00 23 01 00 00 00 00 02 be ae 23 01 00 00 00 00 02 bf 00 23 01 00 00 00 00 02 c0 c0 23 01 00 00 00 00 02 c1 00 23 01 00 00 00 00 02 c2 cd 23 01 00 00 00 00 02 c3 00 23 01 00 00 00 00 02 c4 db 23 01 00 00 00 00 02 c5 01 23 01 00 00 00 00 02 c6 0a 23 01 00 00 00 00 02 c7 01 23 01 00 00 00 00 02 c8 2a 23 01 00 00 00 00 02 c9 01 23 01 00 00 00 00 02 ca 66 23 01 00 00 00 00 02 cb 01 23 01 00 00 00 00 02 cc 95 23 01 00 00 00 00 02 cd 01 23 01 00 00 00 00 02 ce d8 23 01 00 00 00 00 02 cf 02 23 01 00 00 00 00 02 d0 1a 23 01 00 00 00 00 02 d1 02 23 01 00 00 00 00 02 d2 1c 23 01 00 00 00 00 02 d3 02 23 01 00 00 00 00 02 d4 5e 23 01 00 00 00 00 02 d5 02 23 01 00 00 00 00 02 d6 9a 23 01 00 00 00 00 02 d7 02 23 01 00 00 00 00 02 d8 bf 23 01 00 00 00 00 02 d9 02 23 01 00 00 00 00 02 da ed 23 01 00 00 00 00 02 db 03 23 01 00 00 00 00 02 dc 0b 23 01 00 00 00 00 02 dd 03 23 01 00 00 00 00 02 de 36 23 01 00 00 00 00 02 df 03 23 01 00 00 00 00 02 e0 3b 23 01 00 00 00 00 02 e1 03 23 01 00 00 00 00 02 e2 40 23 01 00 00 00 00 02 e3 03 23 01 00 00 00 00 02 e4 45 23 01 00 00 00 00 02 e5 03 23 01 00 00 00 00 02 e6 54 23 01 00 00 00 00 02 e7 03 23 01 00 00 00 00 02 e8 70 23 01 00 00 00 00 02 e9 03 23 01 00 00 00 00 02 ea 8e 23 01 00 00 00 00 02 eb 03 23 01 00 00 00 00 02 ec b2 23 01 00 00 00 00 02 ed 03 23 01 00 00 00 00 02 ee c9 23 01 00 00 00 00 02 ef 00 23 01 00 00 00 00 02 f0 30 23 01 00 00 00 00 02 f1 00 23 01 00 00 00 00 02 f2 43 23 01 00 00 00 00 02 f3 00 23 01 00 00 00 00 02 f4 61 23 01 00 00 00 00 02 f5 00 23 01 00 00 00 00 02 f6 7d 23 01 00 00 00 00 02 f7 00 23 01 00 00 00 00 02 f8 98 23 01 00 00 00 00 02 f9 00 23 01 00 00 00 00 02 fa ae 23 01 00 00 00 00 02 fb 01 23 01 00 00 00 00 02 ff 02 23 01 00 00 00 00 02 00 00 23 01 00 00 00 00 02 01 c0 23 01 00 00 00 00 02 02 00 23 01 00 00 00 00 02 03 cd 23 01 00 00 00 00 02 04 00 23 01 00 00 00 00 02 05 db 23 01 00 00 00 00 02 06 01 23 01 00 00 00 00 02 07 0a 23 01 00 00 00 00 02 08 01 23 01 00 00 00 00 02 09 2a 23 01 00 00 00 00 02 0a 01 23 01 00 00 00 00 02 0b 69 23 01 00 00 00 00 02 0c 01 23 01 00 00 00 00 02 0d 99 23 01 00 00 00 00 02 0e 01 23 01 00 00 00 00 02 0f de 23 01 00 00 00 00 02 10 02 23 01 00 00 00 00 02 11 20 23 01 00 00 00 00 02 12 02 23 01 00 00 00 00 02 13 22 23 01 00 00 00 00 02 14 02 23 01 00 00 00 00 02 15 64 23 01 00 00 00 00 02 16 02 23 01 00 00 00 00 02 17 a0 23 01 00 00 00 00 02 18 02 23 01 00 00 00 00 02 19 c4 23 01 00 00 00 00 02 1a 02 23 01 00 00 00 00 02 1b f3 23 01 00 00 00 00 02 1c 03 23 01 00 00 00 00 02 1d 0f 23 01 00 00 00 00 02 1e 03 23 01 00 00 00 00 02 1f 36 23 01 00 00 00 00 02 20 03 23 01 00 00 00 00 02 21 3b 23 01 00 00 00 00 02 22 03 23 01 00 00 00 00 02 23 40 23 01 00 00 00 00 02 24 03 23 01 00 00 00 00 02 25 45 23 01 00 00 00 00 02 26 03 23 01 00 00 00 00 02 27 54 23 01 00 00 00 00 02 28 03 23 01 00 00 00 00 02 29 70 23 01 00 00 00 00 02 2a 03 23 01 00 00 00 00 02 2b 8e 23 01 00 00 00 00 02 2d 03 23 01 00 00 00 00 02 2f b2 23 01 00 00 00 00 02 30 03 23 01 00 00 00 00 02 31 c9 23 01 00 00 00 00 02 32 00 23 01 00 00 00 00 02 33 30 23 01 00 00 00 00 02 34 00 23 01 00 00 00 00 02 35 43 23 01 00 00 00 00 02 36 00 23 01 00 00 00 00 02 37 61 23 01 00 00 00 00 02 38 00 23 01 00 00 00 00 02 39 7d 23 01 00 00 00 00 02 3a 00 23 01 00 00 00 00 02 3b 98 23 01 00 00 00 00 02 3d 00 23 01 00 00 00 00 02 3f ae 23 01 00 00 00 00 02 40 00 23 01 00 00 00 00 02 41 c0 23 01 00 00 00 00 02 42 00 23 01 00 00 00 00 02 43 cd 23 01 00 00 00 00 02 44 00 23 01 00 00 00 00 02 45 db 23 01 00 00 00 00 02 46 01 23 01 00 00 00 00 02 47 0a 23 01 00 00 00 00 02 48 01 23 01 00 00 00 00 02 49 2a 23 01 00 00 00 00 02 4a 01 23 01 00 00 00 00 02 4b 69 23 01 00 00 00 00 02 4c 01 23 01 00 00 00 00 02 4d 99 23 01 00 00 00 00 02 4e 01 23 01 00 00 00 00 02 4f de 23 01 00 00 00 00 02 50 02 23 01 00 00 00 00 02 51 20 23 01 00 00 00 00 02 52 02 23 01 00 00 00 00 02 53 22 23 01 00 00 00 00 02 54 02 23 01 00 00 00 00 02 55 64 23 01 00 00 00 00 02 56 02 23 01 00 00 00 00 02 58 a0 23 01 00 00 00 00 02 59 02 23 01 00 00 00 00 02 5a c4 23 01 00 00 00 00 02 5b 02 23 01 00 00 00 00 02 5c f3 23 01 00 00 00 00 02 5d 03 23 01 00 00 00 00 02 5e 0f 23 01 00 00 00 00 02 5f 03 23 01 00 00 00 00 02 60 36 23 01 00 00 00 00 02 61 03 23 01 00 00 00 00 02 62 3b 23 01 00 00 00 00 02 63 03 23 01 00 00 00 00 02 64 40 23 01 00 00 00 00 02 65 03 23 01 00 00 00 00 02 66 45 23 01 00 00 00 00 02 67 03 23 01 00 00 00 00 02 68 54 23 01 00 00 00 00 02 69 03 23 01 00 00 00 00 02 6a 70 23 01 00 00 00 00 02 6b 03 23 01 00 00 00 00 02 6c 8e 23 01 00 00 00 00 02 6d 03 23 01 00 00 00 00 02 6e b2 23 01 00 00 00 00 02 6f 03 23 01 00 00 00 00 02 70 c9 23 01 00 00 00 00 02 71 00 23 01 00 00 00 00 02 72 30 23 01 00 00 00 00 02 73 00 23 01 00 00 00 00 02 74 43 23 01 00 00 00 00 02 75 00 23 01 00 00 00 00 02 76 61 23 01 00 00 00 00 02 77 00 23 01 00 00 00 00 02 78 7d 23 01 00 00 00 00 02 79 00 23 01 00 00 00 00 02 7a 98 23 01 00 00 00 00 02 7b 00 23 01 00 00 00 00 02 7c ae 23 01 00 00 00 00 02 7d 00 23 01 00 00 00 00 02 7e c0 23 01 00 00 00 00 02 7f 00 23 01 00 00 00 00 02 80 cd 23 01 00 00 00 00 02 81 00 23 01 00 00 00 00 02 82 db 23 01 00 00 00 00 02 83 01 23 01 00 00 00 00 02 84 0a 23 01 00 00 00 00 02 85 01 23 01 00 00 00 00 02 86 2a 23 01 00 00 00 00 02 87 01 23 01 00 00 00 00 02 88 63 23 01 00 00 00 00 02 89 01 23 01 00 00 00 00 02 8a 90 23 01 00 00 00 00 02 8b 01 23 01 00 00 00 00 02 8c d2 23 01 00 00 00 00 02 8d 02 23 01 00 00 00 00 02 8e 14 23 01 00 00 00 00 02 8f 02 23 01 00 00 00 00 02 90 16 23 01 00 00 00 00 02 91 02 23 01 00 00 00 00 02 92 58 23 01 00 00 00 00 02 93 02 23 01 00 00 00 00 02 94 95 23 01 00 00 00 00 02 95 02 23 01 00 00 00 00 02 96 bc 23 01 00 00 00 00 02 97 02 23 01 00 00 00 00 02 98 ed 23 01 00 00 00 00 02 99 03 23 01 00 00 00 00 02 9a 0b 23 01 00 00 00 00 02 9b 03 23 01 00 00 00 00 02 9c 36 23 01 00 00 00 00 02 9d 03 23 01 00 00 00 00 02 9e 3b 23 01 00 00 00 00 02 9f 03 23 01 00 00 00 00 02 a0 40 23 01 00 00 00 00 02 a2 03 23 01 00 00 00 00 02 a3 45 23 01 00 00 00 00 02 a4 03 23 01 00 00 00 00 02 a5 54 23 01 00 00 00 00 02 a6 03 23 01 00 00 00 00 02 a7 70 23 01 00 00 00 00 02 a9 03 23 01 00 00 00 00 02 aa 8e 23 01 00 00 00 00 02 ab 03 23 01 00 00 00 00 02 ac b2 23 01 00 00 00 00 02 ad 03 23 01 00 00 00 00 02 ae c9 23 01 00 00 00 00 02 af 00 23 01 00 00 00 00 02 b0 30 23 01 00 00 00 00 02 b1 00 23 01 00 00 00 00 02 b2 43 23 01 00 00 00 00 02 b3 00 23 01 00 00 00 00 02 b4 61 23 01 00 00 00 00 02 b5 00 23 01 00 00 00 00 02 b6 7d 23 01 00 00 00 00 02 b7 00 23 01 00 00 00 00 02 b8 98 23 01 00 00 00 00 02 b9 00 23 01 00 00 00 00 02 ba ae 23 01 00 00 00 00 02 bb 00 23 01 00 00 00 00 02 bc c0 23 01 00 00 00 00 02 bd 00 23 01 00 00 00 00 02 be cd 23 01 00 00 00 00 02 bf 00 23 01 00 00 00 00 02 c0 db 23 01 00 00 00 00 02 c1 01 23 01 00 00 00 00 02 c2 0a 23 01 00 00 00 00 02 c3 01 23 01 00 00 00 00 02 c4 2a 23 01 00 00 00 00 02 c5 01 23 01 00 00 00 00 02 c6 63 23 01 00 00 00 00 02 c7 01 23 01 00 00 00 00 02 c8 90 23 01 00 00 00 00 02 c9 01 23 01 00 00 00 00 02 ca d2 23 01 00 00 00 00 02 cb 02 23 01 00 00 00 00 02 cc 14 23 01 00 00 00 00 02 cd 02 23 01 00 00 00 00 02 ce 16 23 01 00 00 00 00 02 cf 02 23 01 00 00 00 00 02 d0 58 23 01 00 00 00 00 02 d1 02 23 01 00 00 00 00 02 d2 95 23 01 00 00 00 00 02 d3 02 23 01 00 00 00 00 02 d4 bc 23 01 00 00 00 00 02 d5 02 23 01 00 00 00 00 02 d6 ed 23 01 00 00 00 00 02 d7 03 23 01 00 00 00 00 02 d8 0b 23 01 00 00 00 00 02 d9 03 23 01 00 00 00 00 02 da 36 23 01 00 00 00 00 02 db 03 23 01 00 00 00 00 02 dc 3b 23 01 00 00 00 00 02 dd 03 23 01 00 00 00 00 02 de 40 23 01 00 00 00 00 02 df 03 23 01 00 00 00 00 02 e0 45 23 01 00 00 00 00 02 e1 03 23 01 00 00 00 00 02 e2 54 23 01 00 00 00 00 02 e3 03 23 01 00 00 00 00 02 e4 70 23 01 00 00 00 00 02 e5 03 23 01 00 00 00 00 02 e6 8e 23 01 00 00 00 00 02 e7 03 23 01 00 00 00 00 02 e8 b2 23 01 00 00 00 00 02 e9 03 23 01 00 00 00 00 02 ea c9 23 01 00 00 00 00 02 fb 01 23 01 00 00 00 00 02 ff 01 23 01 00 00 00 00 02 0b 4b 23 01 00 00 00 00 02 0c 4b 23 01 00 00 00 00 02 0e a1 23 01 00 00 00 00 02 15 0b 23 01 00 00 00 00 02 16 0b 23 01 00 00 00 00 02 1b 1b 23 01 00 00 00 00 02 1c f5 23 01 00 00 00 00 02 01 44 23 01 00 00 00 00 02 5c 82 23 01 00 00 00 00 02 5e 02 23 01 00 00 00 00 02 60 0f 23 01 00 00 00 00 02 66 01 23 01 00 00 00 00 02 69 99 23 01 00 00 00 00 02 6d 33 23 01 00 00 00 00 02 fb 01 23 01 00 00 00 00 02 ff 05 23 01 00 00 00 00 02 35 6b 23 01 00 00 00 00 02 7e 02 23 01 00 00 00 00 02 7f 18 23 01 00 00 00 00 02 81 05 23 01 00 00 00 00 02 82 05 23 01 00 00 00 00 02 a6 04 23 01 00 00 00 00 02 84 03 23 01 00 00 00 00 02 85 04 15 01 00 00 00 00 02 c6 00 23 01 00 00 00 00 02 fb 01 23 01 00 00 00 00 02 ff ff 23 01 00 00 00 00 02 4f 03 23 01 00 00 00 00 02 fb 01 23 01 00 00 00 00 02 ff 00 15 01 00 00 00 00 02 d3 08 15 01 00 00 00 00 02 d4 1b 15 01 00 00 00 00 02 d5 50 15 01 00 00 00 00 02 d6 70];
				qcom,mdss-dsi-on-command = <0x5010000 0x78000111 0x5010000 0x129>;
				qcom,mdss-dsi-off-command = <0x5010000 0x14000128 0x5010000 0x50000110>;
				qcom,mdss-dsi-on-command-state = "dsi_lp_mode";
				qcom,mdss-dsi-off-command-state = "dsi_hs_mode";
				qcom,mdss-dsi-h-sync-pulse = <0x01>;
				qcom,mdss-dsi-traffic-mode = "non_burst_sync_event";
				qcom,mdss-dsi-bllp-eof-power-mode;
				qcom,mdss-dsi-bllp-power-mode;
				qcom,mdss-dsi-lane-0-state;
				qcom,mdss-dsi-lane-1-state;
				qcom,mdss-dsi-lane-2-state;
				qcom,mdss-dsi-lane-3-state;
				qcom,mdss-dsi-panel-timings = <0xe6382600 0x686c2a3c 0x2c030400>;
				qcom,mdss-dsi-lp11-init;
				qcom,mdss-dsi-t-clk-post = <0x02>;
				qcom,mdss-dsi-t-clk-pre = <0x2b>;
				qcom,mdss-dsi-bl-min-level = <0x01>;
				qcom,mdss-dsi-bl-max-level = <0xfff>;
				qcom,mdss-brightness-max-level = <0xfff>;
				qcom,mdss-dsi-dma-trigger = "trigger_sw";
				qcom,mdss-dsi-mdp-trigger = "none";
				qcom,mdss-dsi-bl-pmic-control-type = "bl_ctrl_wled";
				qcom,mdss-dsi-pan-enable-dynamic-fps;
				qcom,mdss-dsi-pan-fps-update = "dfps_suspend_resume_mode";
				qcom,cont-splash-enabled;
				qcom,mdss-dsi-tx-eot-append;
				somc,driver-ic = <0x01>;
				somc,dric-gpio = <0x05 0x1a 0x00>;
				somc,mul-channel-scaling = <0x03>;
				somc,mdss-phy-size-mm = <0x40 0x72>;
				somc,mdss-dsi-lane-config = [00 c2 ef 00 00 00 00 01 75 00 c2 ef 00 00 00 00 01 75 00 c2 ef 00 00 00 00 01 75 00 c2 ef 00 00 00 00 01 75 00 02 45 00 00 00 00 01 97];
				somc,mdss-dsi-disp-on-in-hs = <0x01>;
				somc,lcd-id = <0x01>;
				somc,lcd-id-adc = <0x109618 0x12c898>;
				somc,disp-en-on-pre = <0x05>;
				somc,disp-en-on-post = <0x14>;
				somc,disp-en-off-post = <0x46>;
				somc,pw-on-rst-seq = <0x01 0x0a>;
				somc,pw-off-rst-seq = <0x00 0x00>;
				somc,pw-down-period = <0xc8>;
				somc,mdss-dsi-pre-uv-command = [15 01 00 00 00 00 02 ff 00];
				somc,mdss-dsi-uv-command = <0x6010000 0x1da 0x6010000 0x1db>;
				somc,mdss-dsi-uv-param-type = <0x02>;
				somc,mdss-dsi-pcc-table-size = <0x49>;
				somc,mdss-dsi-pcc-table = <0x00 0x01 0x10 0x13 0x28 0x2b 0x8000 0x7400 0x8000 0x00 0x02 0x14 0x17 0x28 0x2b 0x7a80 0x7400 0x7e00 0x00 0x03 0x18 0x1b 0x28 0x2b 0x7480 0x7380 0x8000 0x00 0x04 0x1c 0x1f 0x28 0x2b 0x7280 0x7380 0x8000 0x00 0x05 0x20 0x23 0x28 0x2b 0x6e00 0x7400 0x8000 0x00 0x06 0x0c 0x0f 0x24 0x27 0x7f80 0x7200 0x7c00 0x00 0x07 0x10 0x13 0x24 0x27 0x8000 0x7400 0x7d80 0x00 0x08 0x14 0x17 0x24 0x27 0x7d00 0x7700 0x7e00 0x00 0x09 0x18 0x1b 0x24 0x27 0x7700 0x7600 0x8000 0x00 0x0a 0x1c 0x1f 0x24 0x27 0x7380 0x7500 0x7c00 0x00 0x0b 0x20 0x23 0x24 0x27 0x6f00 0x7500 0x7e80 0x00 0x0c 0x0c 0x0f 0x20 0x23 0x7f80 0x7200 0x7900 0x00 0x0d 0x10 0x13 0x20 0x23 0x8000 0x7400 0x7b00 0x00 0x0e 0x14 0x17 0x20 0x23 0x7a80 0x7400 0x7b00 0x00 0x0f 0x18 0x1b 0x20 0x23 0x7800 0x7700 0x7e80 0x00 0x10 0x1c 0x1f 0x20 0x23 0x7780 0x7900 0x7f80 0x00 0x11 0x20 0x23 0x20 0x23 0x7300 0x7900 0x7f00 0x00 0x12 0x24 0x27 0x20 0x23 0x7100 0x7980 0x8000 0x00 0x13 0x0c 0x0f 0x1c 0x1f 0x7f80 0x7200 0x7700 0x00 0x14 0x10 0x13 0x1c 0x1f 0x7c00 0x7000 0x7580 0x00 0x15 0x14 0x17 0x1c 0x1f 0x7f80 0x7900 0x7e00 0x00 0x16 0x18 0x1b 0x1c 0x1f 0x7c00 0x7a00 0x7d80 0x00 0x17 0x1c 0x1f 0x1c 0x1f 0x7900 0x7a00 0x7e00 0x00 0x18 0x20 0x23 0x1c 0x1f 0x7600 0x7c80 0x8000 0x00 0x19 0x24 0x27 0x1c 0x1f 0x7300 0x7c00 0x7e80 0x00 0x1a 0x0c 0x0f 0x18 0x1b 0x8000 0x7200 0x7300 0x00 0x1b 0x10 0x13 0x18 0x1b 0x7e80 0x7200 0x7500 0x00 0x1c 0x14 0x17 0x18 0x1b 0x7f00 0x7900 0x7b80 0x00 0x1d 0x18 0x1b 0x18 0x1b 0x7f00 0x7d00 0x7e00 0x00 0x1e 0x1c 0x1f 0x18 0x1b 0x7d00 0x7d80 0x8000 0x00 0x1f 0x20 0x23 0x18 0x1b 0x7900 0x7f00 0x8000 0x00 0x20 0x24 0x27 0x18 0x1b 0x7780 0x8000 0x8000 0x00 0x21 0x10 0x13 0x14 0x17 0x7f80 0x7380 0x7200 0x00 0x22 0x14 0x17 0x14 0x17 0x7f00 0x7900 0x7900 0x00 0x23 0x18 0x1b 0x14 0x17 0x7f00 0x7d00 0x7b80 0xff 0x00 0x1c 0x1f 0x14 0x17 0x8000 0x8000 0x8000 0x00 0x24 0x20 0x23 0x14 0x17 0x7a00 0x8000 0x7e80 0x00 0x25 0x24 0x27 0x14 0x17 0x7780 0x8000 0x7d80 0x00 0x26 0x10 0x13 0x10 0x13 0x8000 0x7400 0x7000 0x00 0x27 0x14 0x17 0x10 0x13 0x7f80 0x7900 0x7680 0x00 0x28 0x18 0x1b 0x10 0x13 0x8000 0x7d80 0x7980 0x00 0x29 0x1c 0x1f 0x10 0x13 0x8000 0x8000 0x7c00 0x00 0x2a 0x20 0x23 0x10 0x13 0x7a00 0x8000 0x7c00 0x00 0x2b 0x10 0x13 0x0c 0x0f 0x7f80 0x7480 0x6f00 0x00 0x2c 0x14 0x17 0x0c 0x0f 0x7f80 0x7900 0x7400 0x00 0x2d 0x18 0x1b 0x0c 0x0f 0x7f80 0x7d80 0x7680 0x00 0x2e 0x1c 0x1f 0x0c 0x0f 0x8000 0x8000 0x7980 0x01 0x00 0x00 0x09 0x32 0x3b 0x8000 0x6d00 0x8000 0x02 0x00 0x0a 0x13 0x32 0x3b 0x7a00 0x7100 0x8000 0x03 0x00 0x14 0x1d 0x32 0x3b 0x7400 0x7180 0x8000 0x04 0x00 0x1e 0x27 0x32 0x3b 0x7100 0x7200 0x8000 0x05 0x00 0x28 0x31 0x32 0x3b 0x6c80 0x7180 0x8000 0x06 0x00 0x32 0x3b 0x32 0x3b 0x6680 0x7300 0x8000 0x07 0x00 0x00 0x09 0x28 0x31 0x8000 0x6b80 0x7080 0x08 0x00 0x0a 0x13 0x28 0x31 0x8000 0x7400 0x8000 0x09 0x00 0x14 0x1d 0x28 0x31 0x7a00 0x7700 0x8000 0x0a 0x00 0x1e 0x27 0x28 0x31 0x7600 0x7780 0x8000 0x0b 0x00 0x28 0x31 0x28 0x31 0x6f80 0x7980 0x8000 0x0c 0x00 0x32 0x3b 0x28 0x31 0x7080 0x7e80 0x8000 0x0d 0x00 0x00 0x09 0x14 0x27 0x8000 0x6b00 0x6d00 0x0e 0x00 0x0a 0x13 0x14 0x27 0x8000 0x7380 0x7480 0xff 0x00 0x14 0x27 0x14 0x27 0x8000 0x8000 0x8000 0x10 0x00 0x28 0x31 0x14 0x27 0x7500 0x8000 0x7e80 0x11 0x00 0x32 0x3b 0x14 0x27 0x7100 0x8000 0x7c80 0x12 0x00 0x00 0x09 0x00 0x09 0x8000 0x6900 0x6500 0x13 0x00 0x00 0x13 0x0a 0x13 0x8000 0x7300 0x6f00 0x13 0x00 0x0a 0x13 0x00 0x09 0x8000 0x7300 0x6f00 0x14 0x00 0x14 0x27 0x0a 0x13 0x7f00 0x8000 0x7900 0x15 0x00 0x14 0x27 0x00 0x09 0x7e80 0x8000 0x7680 0x16 0x00 0x28 0x31 0x0a 0x13 0x7380 0x8000 0x7600 0x17 0x00 0x32 0x3b 0x0a 0x13 0x7080 0x8000 0x7900 0x18 0x00 0x28 0x31 0x00 0x09 0x7a00 0x8000 0x7580 0x19 0x00 0x32 0x3b 0x00 0x09 0x6f00 0x8000 0x7200>;
			};
