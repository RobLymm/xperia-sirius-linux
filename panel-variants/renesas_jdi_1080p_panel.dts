			somc,renesas_jdi_1080p_panel {
				qcom,mdss-dsi-panel-name = "jdi renesas 1080p video";
				qcom,mdss-dsi-panel-controller = <0x23>;
				qcom,mdss-dsi-panel-type = "dsi_video_mode";
				qcom,mdss-dsi-panel-destination = "display_1";
				qcom,mdss-dsi-panel-framerate = <0x3c>;
				qcom,mdss-dsi-virtual-channel-id = <0x00>;
				qcom,mdss-dsi-stream = <0x00>;
				qcom,mdss-dsi-panel-width = <0x438>;
				qcom,mdss-dsi-panel-height = <0x780>;
				qcom,mdss-dsi-h-front-porch = <0x70>;
				qcom,mdss-dsi-h-back-porch = <0x4c>;
				qcom,mdss-dsi-h-pulse-width = <0x04>;
				qcom,mdss-dsi-h-sync-skew = <0x00>;
				qcom,mdss-dsi-v-back-porch = <0x04>;
				qcom,mdss-dsi-v-front-porch = <0x1b>;
				qcom,mdss-dsi-v-pulse-width = <0x04>;
				qcom,mdss-dsi-h-left-border = <0x00>;
				qcom,mdss-dsi-h-right-border = <0x00>;
				qcom,mdss-dsi-v-top-border = <0x00>;
				qcom,mdss-dsi-v-bottom-border = <0x00>;
				qcom,mdss-dsi-bpp = <0x18>;
				qcom,mdss-dsi-underflow-color = <0x00>;
				qcom,mdss-dsi-border-color = <0x00>;
				somc,mdss-dsi-init-command = [05 01 00 00 05 00 01 01 23 01 00 00 00 00 02 b0 00 23 01 00 00 00 00 02 00 00 23 01 00 00 00 00 02 00 00 29 01 00 00 00 00 19 c7 08 12 1b 24 31 48 40 52 5e 61 6a 76 08 12 1b 24 31 48 40 52 5e 61 6a 76 29 01 00 00 00 00 19 c8 08 12 1b 24 31 49 41 53 5e 61 6a 76 08 12 1b 24 31 49 41 53 5e 61 6a 76 29 01 00 00 00 00 19 c9 08 12 1b 24 31 47 3f 52 5e 61 6a 76 08 12 1b 24 31 47 3f 52 5e 61 6a 76 29 01 00 00 00 00 1b d3 1b 33 bb cc c4 33 33 33 00 01 00 a0 d8 a0 06 2b 33 33 22 70 02 2b 43 3d bf 99 23 01 00 00 00 00 02 d6 01];
				qcom,mdss-dsi-on-command = <0x5010000 0x78000111 0x5010000 0x129>;
				qcom,mdss-dsi-off-command = <0x5010000 0x14000128 0x5010000 0x50000110>;
				qcom,mdss-dsi-on-command-state = "dsi_lp_mode";
				qcom,mdss-dsi-off-command-state = "dsi_hs_mode";
				qcom,mdss-dsi-h-sync-pulse = <0x01>;
				qcom,mdss-dsi-traffic-mode = "non_burst_sync_event";
				qcom,mdss-dsi-bllp-eof-power-mode;
				qcom,mdss-dsi-bllp-power-mode;
				qcom,mdss-dsi-lane-0-state;
				qcom,mdss-dsi-lane-1-state;
				qcom,mdss-dsi-lane-2-state;
				qcom,mdss-dsi-lane-3-state;
				qcom,mdss-dsi-panel-timings = <0xe6382600 0x686c2a3c 0x2c030400>;
				qcom,mdss-dsi-lp11-init;
				qcom,mdss-dsi-t-clk-post = <0x02>;
				qcom,mdss-dsi-t-clk-pre = <0x2b>;
				qcom,mdss-dsi-bl-min-level = <0x01>;
				qcom,mdss-dsi-bl-max-level = <0xfff>;
				qcom,mdss-brightness-max-level = <0xfff>;
				qcom,mdss-dsi-dma-trigger = "trigger_sw";
				qcom,mdss-dsi-mdp-trigger = "none";
				qcom,mdss-dsi-bl-pmic-control-type = "bl_ctrl_wled";
				qcom,mdss-dsi-pan-enable-dynamic-fps;
				qcom,mdss-dsi-pan-fps-update = "dfps_suspend_resume_mode";
				qcom,cont-splash-enabled;
				qcom,mdss-dsi-tx-eot-append;
				somc,driver-ic = <0x00>;
				somc,dric-gpio = <0x05 0x1a 0x00>;
				somc,mul-channel-scaling = <0x03>;
				somc,mdss-phy-size-mm = <0x40 0x72>;
				somc,mdss-dsi-lane-config = [00 c2 ef 00 00 00 00 01 75 00 c2 ef 00 00 00 00 01 75 00 c2 ef 00 00 00 00 01 75 00 c2 ef 00 00 00 00 01 75 00 02 45 00 00 00 00 01 97];
				somc,mdss-dsi-disp-on-in-hs = <0x01>;
				somc,lcd-id = <0x01>;
				somc,lcd-id-adc = <0x562e8 0x65130>;
				somc,disp-en-on-pre = <0x05>;
				somc,disp-en-on-post = <0x0f>;
				somc,disp-en-off-post = <0x46>;
				somc,pw-on-rst-seq = <0x01 0x0a>;
				somc,pw-off-rst-seq = <0x00 0x00>;
				somc,mdss-dsi-pre-uv-command = [23 01 00 00 00 00 02 b0 04];
				somc,mdss-dsi-uv-command = <0x6010000 0x1da 0x6010000 0x1db>;
				somc,mdss-dsi-uv-param-type = <0x04>;
				somc,mdss-dsi-pcc-table-size = <0x49>;
				somc,mdss-dsi-pcc-table = <0x00 0x01 0x10 0x13 0x28 0x2b 0x8000 0x7400 0x8000 0x00 0x02 0x14 0x17 0x28 0x2b 0x7a80 0x7400 0x7e00 0x00 0x03 0x18 0x1b 0x28 0x2b 0x7480 0x7380 0x8000 0x00 0x04 0x1c 0x1f 0x28 0x2b 0x7280 0x7380 0x8000 0x00 0x05 0x20 0x23 0x28 0x2b 0x6e00 0x7400 0x8000 0x00 0x06 0x0c 0x0f 0x24 0x27 0x7f80 0x7200 0x7c00 0x00 0x07 0x10 0x13 0x24 0x27 0x8000 0x7400 0x7d80 0x00 0x08 0x14 0x17 0x24 0x27 0x7d00 0x7700 0x7e00 0x00 0x09 0x18 0x1b 0x24 0x27 0x7700 0x7600 0x8000 0x00 0x0a 0x1c 0x1f 0x24 0x27 0x7380 0x7500 0x7c00 0x00 0x0b 0x20 0x23 0x24 0x27 0x6f00 0x7500 0x7e80 0x00 0x0c 0x0c 0x0f 0x20 0x23 0x7f80 0x7200 0x7900 0x00 0x0d 0x10 0x13 0x20 0x23 0x8000 0x7400 0x7b00 0x00 0x0e 0x14 0x17 0x20 0x23 0x7a80 0x7400 0x7b00 0x00 0x0f 0x18 0x1b 0x20 0x23 0x7800 0x7700 0x7e80 0x00 0x10 0x1c 0x1f 0x20 0x23 0x7780 0x7900 0x7f80 0x00 0x11 0x20 0x23 0x20 0x23 0x7300 0x7900 0x7f00 0x00 0x12 0x24 0x27 0x20 0x23 0x7100 0x7980 0x8000 0x00 0x13 0x0c 0x0f 0x1c 0x1f 0x7f80 0x7200 0x7700 0x00 0x14 0x10 0x13 0x1c 0x1f 0x7c00 0x7000 0x7580 0x00 0x15 0x14 0x17 0x1c 0x1f 0x7f80 0x7900 0x7e00 0x00 0x16 0x18 0x1b 0x1c 0x1f 0x7c00 0x7a00 0x7d80 0x00 0x17 0x1c 0x1f 0x1c 0x1f 0x7900 0x7a00 0x7e00 0x00 0x18 0x20 0x23 0x1c 0x1f 0x7600 0x7c80 0x8000 0x00 0x19 0x24 0x27 0x1c 0x1f 0x7300 0x7c00 0x7e80 0x00 0x1a 0x0c 0x0f 0x18 0x1b 0x8000 0x7200 0x7300 0x00 0x1b 0x10 0x13 0x18 0x1b 0x7e80 0x7200 0x7500 0x00 0x1c 0x14 0x17 0x18 0x1b 0x7f00 0x7900 0x7b80 0x00 0x1d 0x18 0x1b 0x18 0x1b 0x7f00 0x7d00 0x7e00 0x00 0x1e 0x1c 0x1f 0x18 0x1b 0x7d00 0x7d80 0x8000 0x00 0x1f 0x20 0x23 0x18 0x1b 0x7900 0x7f00 0x8000 0x00 0x20 0x24 0x27 0x18 0x1b 0x7780 0x8000 0x8000 0x00 0x21 0x10 0x13 0x14 0x17 0x7f80 0x7380 0x7200 0x00 0x22 0x14 0x17 0x14 0x17 0x7f00 0x7900 0x7900 0x00 0x23 0x18 0x1b 0x14 0x17 0x7f00 0x7d00 0x7b80 0xff 0x00 0x1c 0x1f 0x14 0x17 0x8000 0x8000 0x8000 0x00 0x24 0x20 0x23 0x14 0x17 0x7a00 0x8000 0x7e80 0x00 0x25 0x24 0x27 0x14 0x17 0x7780 0x8000 0x7d80 0x00 0x26 0x10 0x13 0x10 0x13 0x8000 0x7400 0x7000 0x00 0x27 0x14 0x17 0x10 0x13 0x7f80 0x7900 0x7680 0x00 0x28 0x18 0x1b 0x10 0x13 0x8000 0x7d80 0x7980 0x00 0x29 0x1c 0x1f 0x10 0x13 0x8000 0x8000 0x7c00 0x00 0x2a 0x20 0x23 0x10 0x13 0x7a00 0x8000 0x7c00 0x00 0x2b 0x10 0x13 0x0c 0x0f 0x7f80 0x7480 0x6f00 0x00 0x2c 0x14 0x17 0x0c 0x0f 0x7f80 0x7900 0x7400 0x00 0x2d 0x18 0x1b 0x0c 0x0f 0x7f80 0x7d80 0x7680 0x00 0x2e 0x1c 0x1f 0x0c 0x0f 0x8000 0x8000 0x7980 0x01 0x00 0x00 0x09 0x32 0x3b 0x8000 0x6d00 0x8000 0x02 0x00 0x0a 0x13 0x32 0x3b 0x7a00 0x7100 0x8000 0x03 0x00 0x14 0x1d 0x32 0x3b 0x7400 0x7180 0x8000 0x04 0x00 0x1e 0x27 0x32 0x3b 0x7100 0x7200 0x8000 0x05 0x00 0x28 0x31 0x32 0x3b 0x6c80 0x7180 0x8000 0x06 0x00 0x32 0x3b 0x32 0x3b 0x6680 0x7300 0x8000 0x07 0x00 0x00 0x09 0x28 0x31 0x8000 0x6b80 0x7080 0x08 0x00 0x0a 0x13 0x28 0x31 0x8000 0x7400 0x8000 0x09 0x00 0x14 0x1d 0x28 0x31 0x7a00 0x7700 0x8000 0x0a 0x00 0x1e 0x27 0x28 0x31 0x7600 0x7780 0x8000 0x0b 0x00 0x28 0x31 0x28 0x31 0x6f80 0x7980 0x8000 0x0c 0x00 0x32 0x3b 0x28 0x31 0x7080 0x7e80 0x8000 0x0d 0x00 0x00 0x09 0x14 0x27 0x8000 0x6b00 0x6d00 0x0e 0x00 0x0a 0x13 0x14 0x27 0x8000 0x7380 0x7480 0xff 0x00 0x14 0x27 0x14 0x27 0x8000 0x8000 0x8000 0x10 0x00 0x28 0x31 0x14 0x27 0x7500 0x8000 0x7e80 0x11 0x00 0x32 0x3b 0x14 0x27 0x7100 0x8000 0x7c80 0x12 0x00 0x00 0x09 0x00 0x09 0x8000 0x6900 0x6500 0x13 0x00 0x00 0x13 0x0a 0x13 0x8000 0x7300 0x6f00 0x13 0x00 0x0a 0x13 0x00 0x09 0x8000 0x7300 0x6f00 0x14 0x00 0x14 0x27 0x0a 0x13 0x7f00 0x8000 0x7900 0x15 0x00 0x14 0x27 0x00 0x09 0x7e80 0x8000 0x7680 0x16 0x00 0x28 0x31 0x0a 0x13 0x7380 0x8000 0x7600 0x17 0x00 0x32 0x3b 0x0a 0x13 0x7080 0x8000 0x7900 0x18 0x00 0x28 0x31 0x00 0x09 0x7a00 0x8000 0x7580 0x19 0x00 0x32 0x3b 0x00 0x09 0x6f00 0x8000 0x7200>;
			};
